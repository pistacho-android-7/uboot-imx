## board/nutsboard/coconut/Kconfig
```kconfig
if TARGET_COCONUT

config SYS_BOARD
	default "coconut"

config SYS_VENDOR
	default "nutsboard"

config SYS_SOC
	default "mx6"

config SYS_CONFIG_NAME
	default "coconut"

endif
```

## board/nutsboard/pistachio-lite/Kconfig
```kconfig
if TARGET_PISTACHIO_LITE

config SYS_BOARD
	default "pistachio-lite"

config SYS_VENDOR
	default "nutsboard"

config SYS_SOC
	default "mx6"

config SYS_CONFIG_NAME
	default "pistachio-lite"

endif
```

## board/nutsboard/pistachio/Kconfig
```kconfig
if TARGET_PISTACHIO

config SYS_BOARD
	default "pistachio"

config SYS_VENDOR
	default "nutsboard"

config SYS_SOC
	default "mx6"

config SYS_CONFIG_NAME
	default "pistachio"

endif
```

## configs/mx6_pistachio-lite_android_defconfig
```kconfig
CONFIG_SYS_EXTRA_OPTIONS="IMX_CONFIG=board/nutsboard/pistachio-lite/mx6q_4x_mt41k256_2g.cfg,MX6Q,ANDROID_SUPPORT"
CONFIG_ARM=y
CONFIG_TARGET_PISTACHIO_LITE=y
CONFIG_SYS_MALLOC_F=y
CONFIG_SYS_MALLOC_F_LEN=0x400
CONFIG_DM=y
CONFIG_DM_THERMAL=y
```

## configs/mx6_pistachio_android_defconfig
```kconfig
CONFIG_SYS_EXTRA_OPTIONS="IMX_CONFIG=board/nutsboard/pistachio/mx6q_4x_mt41j128.cfg,MX6Q,ANDROID_SUPPORT"
CONFIG_ARM=y
CONFIG_TARGET_PISTACHIO=y
CONFIG_SYS_MALLOC_F=y
CONFIG_SYS_MALLOC_F_LEN=0x400
CONFIG_DM=y
CONFIG_DM_THERMAL=y
```

## configs/mx6ul_coconut_defconfig
```kconfig
CONFIG_SYS_EXTRA_OPTIONS="IMX_CONFIG=board/nutsboard/coconut/imximage.cfg,MX6UL,SYS_BOOT_NAND"
CONFIG_ARM=y
CONFIG_TARGET_COCONUT=y
CONFIG_DM=y
CONFIG_DM_THERMAL=y
```
